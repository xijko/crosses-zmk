#include <physical_layouts.dtsi>

/ {
    physical_layout0: physical_layout_0 {
        compatible = "zmk,physical-layout";
        display-name = "LAYOUT_default";

        kscan = <&kscan0>;
        transform = <&matrix_transform0>;
    };
};
