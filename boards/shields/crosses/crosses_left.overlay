#include "crosses.dtsi"

&kscan0 {
  col-gpios
    = <&gpio0 2 GPIO_ACTIVE_HIGH>
    , <&gpio1 15 GPIO_ACTIVE_HIGH>
    , <&gpio1 13 GPIO_ACTIVE_HIGH>
    , <&gpio1 11 GPIO_ACTIVE_HIGH>
    , <&gpio0 10 GPIO_ACTIVE_HIGH>
    , <&gpio0 9 GPIO_ACTIVE_HIGH>
    ;

    row-gpios
      = <&gpio0 22 (GPIO_ACTIVE_HIGH | GPIO_PULL_DOWN)>
      , <&gpio0 24 (GPIO_ACTIVE_HIGH | GPIO_PULL_DOWN)>
      , <&gpio1 0 (GPIO_ACTIVE_HIGH | GPIO_PULL_DOWN)>
      , <&gpio0 11 (GPIO_ACTIVE_HIGH | GPIO_PULL_DOWN)>
      , <&gpio1 4 (GPIO_ACTIVE_HIGH | GPIO_PULL_DOWN)>
      , <&gpio1 6 (GPIO_ACTIVE_HIGH | GPIO_PULL_DOWN)>
      ;
};

&left_encoder {
    status = "okay";
};

/*
/{
split_inputs {
    #address-cells = <1>;
    #size-cells = <0>;
    glidepoint_split: glidepoint_split@0{
        compatible = "zmk,input-split";
        reg = <0>;
    };
};

glidepoint_listener: glidepoint_listener {
    compatible = "zmk,input-listener";
    status = "okay";
    device = <&glidepoint_split>;
};
}
*/
