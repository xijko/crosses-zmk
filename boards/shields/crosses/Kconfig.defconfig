## boards/shields/crosses/Kconfig.defconfig
```kconfig
CONFIG_ZMK_USB=y
CONFIG_LOG_PROCESS_THREAD_STARTUP_DELAY_MS = 8000

if SHIELD_CROSSES_RIGHT

config ZMK_KEYBOARD_NAME
  default "Crossyboi BLE"

config ZMK_SPLIT_ROLE_CENTRAL
  default y

endif

if SHIELD_CROSSES_LEFT || SHIELD_CROSSES_RIGHT

config ZMK_SPLIT
  default y

endif
```

## boards/shields/crosses/Kconfig.shield
```kconfig
config SHIELD_CROSSES_LEFT
  def_bool $(shields_list_contains,crosses_left)

config SHIELD_CROSSES_RIGHT
  def_bool $(shields_list_contains,crosses_right)

# No whitespace after the comma or in the keyboard name!
config SHIELD_CROSSES_DONGLE
    def_bool $(shields_list_contains,crosses_dongle)
```

## config/west.yml
```yaml
manifest:
  remotes:
    - name: zmkfirmware
      url-base: https://github.com/zmkfirmware
#    - name: petejohanson # <-- enable the drivers
#      url-base: https://github.com/petejohanson
  projects:
#    - name: cirque-input-module
#      remote: petejohanson
#      revision: main
    - name: zmk
      remote: zmkfirmware
      revision: main
      import: app/west.yml
  self:
    path: config
```
