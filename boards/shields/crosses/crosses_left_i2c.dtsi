/*
 * Copyright (c) 2021 The ZMK Contributors
 *
 * SPDX-License-Identifier: MIT
 */

#include <input/processors.dtsi>
#include <dt-bindings/zmk/input_transform.h>
#include "crosses.dtsi"

// Cirque Trackpad if the Left side is central, comment otherwise
